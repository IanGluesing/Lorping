// ============================================================
// Built-In Libraries
// ============================================================

#include <Arduino.h>
#include <RadioLib.h>

#include "lwip/init.h"
#include "lwip/netif.h"
#include "lwip/pbuf.h"
#include "lwip/ip_addr.h"
#include "lwip/ip4_addr.h"
#include "lwip/ip.h"
#include "lwip/icmp.h"
#include "lwip/inet_chksum.h"
#include "lwip/timeouts.h"
#include "lwip/mem.h"
#include "lwip/memp.h"
#include "lwip/ip4.h"
#include "lwip/ip4_addr.h"
#include "lwip/tcp.h"

// ============================================================
// Local Libraries
// ============================================================

#include <datalink_receive.h>
#include <datalink_transmit.h>
#include <device_config.h>
#include <lora_config.h>
#include <ping.h>
#include <udp_config.h>
#include <udp_utils.h>
#include <tcp_utils.h>

// ============================================================
// SX1262 Lora Module
// ============================================================

SX1262 radio = new Module(
    PIN_CS,
    PIN_DIO1,
    PIN_RESET,
    PIN_BUSY
);

// ============================================================
// IP configuration
// ============================================================

// Change IS_TRANSMITTER to false when compiling GIGA B.
constexpr bool IS_TRANSMITTER = false;

constexpr uint8_t LOCAL_IP_LAST = IS_TRANSMITTER ? 1 : 2;
constexpr uint8_t REMOTE_IP_LAST = IS_TRANSMITTER ? 2 : 1;

// ============================================================
// LWIP network interface
// ============================================================

// Network interface with lora module as the hardware link
struct netif lora_netif_network_interface;

// UDP socket
struct udp_pcb *udpPcb = nullptr;
// TCP socket
struct tcp_pcb *tcpPcb = nullptr;

// ============================================================
// Radio receive state
// ============================================================

volatile bool dio1Triggered = false;
volatile bool radioPacketReceived = false;

void radioReceiveISR()
{
    dio1Triggered = true;
}

// ============================================================
// LoRa network interface TX
// ============================================================
//
// LWIP calls this when it wants to send an IP packet.
//
// p->payload / p->len contain the packet data.
//
// ============================================================

err_t lora_output(
    struct netif *netif,
    struct pbuf *p,
    const ip4_addr_t *ipaddr)
{
    (void)netif;
    (void)ipaddr;

    Serial.println("LWIP IPv4 output called");

    return data_out_to_lora_module(netif, p);
}

// ============================================================
//
// Transmit data over the given network interface
//
// netif->output = lora_output
// netif->linkoutput = data_out_to_lora_module
// 
// Given network interface and pbuf data send over the Sx1262.
// This same path will be used if a packet is generated by netif.
//
// Packet goes to netif->output = lora_output
// Packet goes to netif->linkoutput = data_out_to_lora_module
// Packet goes to SX1262 to transmit out
//
// ============================================================
err_t data_out_to_lora_module(
    struct netif *netif,
    struct pbuf *p)
{
    (void)netif;

    Serial.print("LWIP TX packet, length=");
    Serial.println(p->tot_len);

    if (p->tot_len > sizeof(txBuffer)) {
        Serial.println("Packet too large");
        return ERR_BUF;
    }

    // --------------------------------------------------------
    // Flatten the LWIP pbuf chain into one contiguous buffer.
    // --------------------------------------------------------

    uint16_t offset = 0;

    for (struct pbuf *q = p; q != nullptr; q = q->next) {

        memcpy(
            &txBuffer[offset],
            q->payload,
            q->len
        );

        offset += q->len;
    }

    // --------------------------------------------------------
    // Transmit over SX1262.
    // --------------------------------------------------------

    radio.standby();
    int state = radio.transmit(
        txBuffer,
        offset
    );

    if (state != RADIOLIB_ERR_NONE) {

        Serial.print("LoRa TX failed: ");
        Serial.println(state);

        return ERR_IF;
    }

    Serial.println("LoRa TX complete");

    // Only return to RX after the TX is completely finished.
    radio.startReceive();

    return ERR_OK;
}


// ============================================================
// LWIP network interface initialization
// ============================================================

err_t initialize_lora_netif_network_interface(
    struct netif *param_lora_netif_network_interface)
{
    param_lora_netif_network_interface->name[0] = 'l';
    param_lora_netif_network_interface->name[1] = 'r';

    param_lora_netif_network_interface->output = lora_output;

    param_lora_netif_network_interface->linkoutput =
        data_out_to_lora_module;

    param_lora_netif_network_interface->mtu = 200;

    param_lora_netif_network_interface->flags =
        NETIF_FLAG_UP |
        NETIF_FLAG_LINK_UP;

    return ERR_OK;
}

// ============================================================
// Handle when an outgoing TCP connection is established
// ============================================================

err_t tcpConnectedCallback(
    void *arg,
    tcp_pcb *pcb,
    err_t err
)
{
    if (err != ERR_OK) {
        Serial.print("TCP connection failed: ");
        Serial.println(err);
        return err;
    }

    Serial.println("TCP connection established!");

    // Store/use the connected PCB here.
    tcpPcb = pcb;

    return ERR_OK;
}

// ============================================================
// Setup
// ============================================================

void setup()
{
    Serial.begin(115200);
    delay(2000);

    // ========================================================
    // Initial logging
    // ========================================================

    Serial.println();
    Serial.println("=================================");
    Serial.println("GIGA SX1262 LWIP Network");
    Serial.println("=================================");

    Serial.print("Device: ");

    if (IS_TRANSMITTER) {
        Serial.println("A");
    } else {
        Serial.println("B");
    }

    Serial.print("IP: 10.0.0.");
    Serial.println(LOCAL_IP_LAST);

    // ========================================================
    // Initialize LWIP
    // ========================================================

    lwip_init();

    // ========================================================
    // Configure IP addresses for network interface
    // ========================================================

    ip4_addr_t ip;
    ip4_addr_t netmask;
    ip4_addr_t gateway;

    IP4_ADDR(&ip, 10, 0, 0, LOCAL_IP_LAST);
    IP4_ADDR(&netmask, 255, 255, 255, 0);
    IP4_ADDR(&gateway, 0, 0, 0, 0);

    // ========================================================
    // Add LoRa interface to LWIP
    // ========================================================

    struct netif *result = netif_add(
        &lora_netif_network_interface,
        &ip,
        &netmask,
        &gateway,
        nullptr,
        initialize_lora_netif_network_interface,
        ip_input
    );

    if (result == nullptr) {
        Serial.println("ERROR: netif_add failed");

        while (true) {
            delay(1000);
        }
    }

    netif_set_up(&lora_netif_network_interface);
    netif_set_link_up(&lora_netif_network_interface);
    netif_set_default(&lora_netif_network_interface);

    // ========================================================
    // Initialize SX1262 module
    // ========================================================

    auto radio_result = radio.begin(
        INITIAL_LORA_FREQUENCY,
        INITIAL_LORA_BANDWIDTH,
        LORA_SPREADING_FACTOR,
        LORA_CODING_RATE
    );

    if (radio_result != RADIOLIB_ERR_NONE) {

        Serial.print("SX1262 initialization failed: ");
        Serial.println(radio_result);

        while (true) {
            delay(1000);
        }
    }

    radio.setDio1Action(radioReceiveISR);

    // // ========================================================
    // // Start udp
    // // ========================================================

    // if (!setupUDP(udpPcb)) {

    //     Serial.println("UDP initialization failed");

    //     while (true) {
    //         delay(1000);
    //     }
    // }

    // ========================================================
    // Start TCP
    // ========================================================

    if (!IS_TRANSMITTER) {

        // Create tcp pcb
        tcpPcb = tcp_new();

        // Bind to port
        tcp_bind(tcpPcb, IP_ADDR_ANY, 5000);

        // Listen on port
        tcpPcb = tcp_listen(tcpPcb);

        // Accept incoming connection
        tcp_accept(tcpPcb, tcpAcceptCallback);

    }

    // ========================================================
    // Start SX1262 receive
    // ========================================================

    radio_result =
        radio.startReceive();

    if (radio_result != RADIOLIB_ERR_NONE) {
        Serial.print("startReceive failed: ");
        Serial.println(radio_result);

        while (true) {
            delay(1000);
        }
    }

    if (IS_TRANSMITTER) {
        tcpPcb = tcp_new();

        ip4_addr_t serverIP;
        IP4_ADDR(&serverIP, 10, 0, 0, 2);

        tcp_connect(
            tcpPcb,
            &serverIP,
            5000,
            tcpConnectedCallback
        );
    }
    
    Serial.println("All funcitons intialized successfully, looping...");
}

// ============================================================
// Loop
// ============================================================

void loop()
{
    // --------------------------------------------------------
    // Handle incoming LoRa packets.
    // --------------------------------------------------------

    if (radioPacketReceived) {
        radioPacketReceived = false;
        processLoRaReceive(&radio, &lora_netif_network_interface);
    }

    // --------------------------------------------------------
    // LWIP timers.
    // --------------------------------------------------------

    sys_check_timeouts();

    // --------------------------------------------------------
    // GIGA A periodically sends a ping.
    // --------------------------------------------------------

    if (IS_TRANSMITTER) {
        static uint32_t lastPing = 0;

        if (millis() - lastPing >= 5000) {
            lastPing = millis();

            // sendUDP(udpPcb, REMOTE_IP_LAST);
            sendPing(
                &lora_netif_network_interface,
                LOCAL_IP_LAST, 
                REMOTE_IP_LAST);
        }
    }

    // 3. Handle the event safely in the main loop
    if (dio1Triggered) {
        dio1Triggered = false; // Reset the flag immediately

        // Read the hardware IRQ status register via SPI
        uint32_t irqStatus = radio.getIrqFlags();

        // Check if Transmission Finished
        if (irqStatus & RADIOLIB_SX126X_IRQ_TX_DONE) {
            Serial.println(F("\nEvent: TX Done! Packet sent successfully."));
            // Handle your next action after a successful send
        }

        // Check if Data was Received
        if (irqStatus & RADIOLIB_SX126X_IRQ_RX_DONE) {
            Serial.println(F("\nEvent: Rx Done!"));
            radioPacketReceived = true;
        }

        // Optional: Always clear the hardware flags after reading them
        radio.clearIrqFlags(RADIOLIB_SX126X_IRQ_TX_DONE | RADIOLIB_SX126X_IRQ_RX_DONE);
    }

    delay(1);
}
